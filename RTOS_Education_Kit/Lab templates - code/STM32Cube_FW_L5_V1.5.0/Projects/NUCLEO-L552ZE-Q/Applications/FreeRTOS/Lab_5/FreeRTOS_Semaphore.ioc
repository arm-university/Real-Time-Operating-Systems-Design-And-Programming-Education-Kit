# file: FreeRTOS_Semaphore.ioc
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FREERTOS.BinarySemaphores01=osSemaphore,Dynamic,NULL
FREERTOS.HEAP_NUMBER=4
FREERTOS.INCLUDE_eTaskGetState=1
FREERTOS.INCLUDE_pcTaskGetTaskName=0
FREERTOS.INCLUDE_uxTaskGetStackHighWaterMark=1
FREERTOS.INCLUDE_uxTaskPriorityGet=1
FREERTOS.INCLUDE_vTaskCleanUpResources=1
FREERTOS.INCLUDE_vTaskDelay=1
FREERTOS.INCLUDE_vTaskDelayUntil=1
FREERTOS.INCLUDE_vTaskDelete=1
FREERTOS.INCLUDE_vTaskPrioritySet=1
FREERTOS.INCLUDE_vTaskSuspend=1
FREERTOS.INCLUDE_xEventGroupSetBitFromISR=0
FREERTOS.INCLUDE_xQueueGetMutexHolder=1
FREERTOS.INCLUDE_xSemaphoreGetMutexHolder=0
FREERTOS.INCLUDE_xTaskAbortDelay=0
FREERTOS.INCLUDE_xTaskGetCurrentTaskHandle=1
FREERTOS.INCLUDE_xTaskGetHandle=0
FREERTOS.INCLUDE_xTaskGetSchedulerState=1
FREERTOS.INCLUDE_xTaskResumeFromISR=0
FREERTOS.INCLUDE_xTimerPendFunctionCall=1
FREERTOS.Tasks01=SEM_Thread1,24,512,SemaphoreThread1,Default,(void *) osSemaphoreHandle,Dynamic,NULL,NULL;SEM_Thread2,8,512,SemaphoreThread2,Default,(void *) osSemaphoreHandle,Dynamic,NULL,NULL
FREERTOS.configCHECK_FOR_STACK_OVERFLOW=0
FREERTOS.configENABLE_BACKWARD_COMPATIBILITY=0
FREERTOS.configENABLE_FPU=1
FREERTOS.configGENERATE_RUN_TIME_STATS=0
FREERTOS.configIDLE_SHOULD_YIELD=1
FREERTOS.configLIBRARY_LOWEST_INTERRUPT_PRIORITY=7
FREERTOS.configLIBRARY_MAX_SYSCALL_INTERRUPT_PRIORITY=5
FREERTOS.configMAX_CO_ROUTINE_PRIORITIES=2
FREERTOS.configMAX_TASK_NAME_LEN=16
FREERTOS.configMINIMAL_STACK_SIZE=512
FREERTOS.configQUEUE_REGISTRY_SIZE=8
FREERTOS.configRECORD_STACK_HIGH_ADDRESS=0
FREERTOS.configTICK_RATE_HZ=1000
FREERTOS.configTIMER_QUEUE_LENGTH=10
FREERTOS.configTIMER_TASK_PRIORITY=2
FREERTOS.configTIMER_TASK_STACK_DEPTH=1024
FREERTOS.configTOTAL_HEAP_SIZE=8120
FREERTOS.configUSE_APPLICATION_TASK_TAG=0
FREERTOS.configUSE_COUNTING_SEMAPHORES=1
FREERTOS.configUSE_CO_ROUTINES=0
FREERTOS.configUSE_DAEMON_TASK_STARTUP_HOOK=0
FREERTOS.configUSE_IDLE_HOOK=0
FREERTOS.configUSE_MALLOC_FAILED_HOOK=0
FREERTOS.configUSE_MUTEXES=1
FREERTOS.configUSE_PREEMPTION=1
FREERTOS.configUSE_RECURSIVE_MUTEXES=1
FREERTOS.configUSE_STATS_FORMATTING_FUNCTIONS=0
FREERTOS.configUSE_TASK_NOTIFICATIONS=1
FREERTOS.configUSE_TICKLESS_IDLE=0
FREERTOS.configUSE_TICK_HOOK=0
FREERTOS.configUSE_TRACE_FACILITY=1
Mcu.Family=STM32L5
Mcu.Name=STM32L552Z(C-E)TxQ
Mcu.Package=LQFP144
Mcu.TrustZone=disable
NVIC.PriorityGroup=NVIC_PRIORITYGROUP_3
NVIC.TIM6_IRQn=true\:0\:0\:false\:false\:true\:false\:false\:true
NVIC.TimeBase=TIM6_IRQn
NVIC.TimeBaseIP=TIM6
ProjectManager.HeapSize=0x400
ProjectManager.StackSize=0x800
ProjectManager.TargetToolchain=EWARM V8.32
RCC.ADCCLockSelection=RCC_ADCCLKSOURCE_SYSCLK
RCC.ADCFreq_Value=110000000
RCC.AHBFreq_Value=110000000
RCC.APB1Freq_Value=110000000
RCC.APB1TimFreq_Value=110000000
RCC.APB2Freq_Value=110000000
RCC.APB2TimFreq_Value=110000000
RCC.CK48CLockSelection=RCC_USBCLKSOURCE_MSI
RCC.CortexFreq_Value=110000000
RCC.DATA_CACHE_ENABLE=0
RCC.HCLKFreq_Value=110000000
RCC.HSE_VALUE=16000000
RCC.HSI48_VALUE=48000000
RCC.HSI_VALUE=16000000
RCC.I2C1CLockSelection=RCC_I2C1CLKSOURCE_SYSCLK
RCC.I2C3CLockSelection=RCC_I2C3CLKSOURCE_HSI
RCC.INSTRUCTION_CACHE_ENABLE=0
RCC.LSE_VALUE=32768
RCC.MSI_VALUE=4000000
RCC.PLLN=55
RCC.PLLSAI1N=24
RCC.SYSCLKFreq_VALUE=110000000
RCC.SYSCLKSource=RCC_SYSCLKSOURCE_PLLCLK
RCC.USBFreq_Value=4000000
RCC.VCOOutputFreq_Value=220000000
VP_FREERTOS_VS_CMSIS_V2.Mode=CMSIS_V2
VP_ICACHE_VS_ICACHE.Mode=DirectMappedCache
VP_PWR_VS_DBSignals.Mode=DisableDeadBatterySignals
VP_SYS_VS_tim6.Mode=TIM6
board=custom

// file: Src/main.c
#include "main.h"
#include "cmsis_os.h"
#include <stdlib.h>

/* USER CODE BEGIN PM */
#define RMIN      (SystemCoreClock / 20)
#define RMAX      (SystemCoreClock / 10)
#define RDIV      5
#define RAMT      ((RMAX - RMIN) / RDIV)
#define RANDOM_SEED 0

#define BUFFER_SIZE 10
#define MIN(X, Y) ((X) < (Y) ? (X) : (Y))
/* USER CODE END PM */
int buffer[BUFFER_SIZE];
int producer_datum;
int consumer_datum;
int i = 0;
int tickets;

osThreadId_t ThreadID1;
osThreadId_t ThreadID2;

osMutexId_t mutexID;
osSemaphoreId_t semID;
osSemaphoreId_t semID1;
osSemaphoreId_t semID2;
osSemaphoreId_t semIDA;
osSemaphoreId_t semIDB;

/* Definitions for SEM_Thread1 */
const osMutexAttr_t mutexAttr = {
    .name = "mutex"
};

const osSemaphoreAttr_t semAttr = {
    .name = "sem"
};

void Delay(uint32_t nCount) {
    while(nCount--) {
        __NOP();
    }
}

void SystemClock_Config(void);
static void MX_ICACHE_Init(void);
void general_init_sem(int initial_value);
void Producer_0(void *arg);
void Consumer_0(void *arg);
void Producer_1(void *arg);
void Consumer_1(void *arg);
void Producer_2(void *arg);
void Consumer_2(void *arg);
void Producer_3(void *arg);
void Consumer_3(void *arg);
void Producer_4(void *arg);
void Consumer_4(void *arg);
void Producer_5(void *arg);
void Consumer_5(void *arg);
void Producer_6(void *arg);
void Consumer_6(void *arg);

int main(void)
{

  /* MCU Configuration--------------------------------------------------------*/

  /* Reset of all peripherals, Initializes the Flash interface and the Systick. */
  HAL_Init();

	BSP_LED_Init(LED3); // RED (unused in this version)
  BSP_LED_Init(LED1); // GREEN
  BSP_LED_Init(LED2); // BLUE

  /* Configure the system clock */
  SystemClock_Config();

  /* USER CODE BEGIN SysInit */
  /* Initialize LEDs */
  /* USER CODE END SysInit */

  /* Initialize all configured peripherals */
  MX_ICACHE_Init();

  /* Init scheduler */
	srand(RANDOM_SEED);
  Delay(RMIN);

  osKernelInitialize();

  /* Create the semaphores(s) */
  /* creation of osSemaphore */
  mutexID = osMutexNew(&mutexAttr);
  semID = osSemaphoreNew(BUFFER_SIZE, 0, &semAttr);
  semID1 = osSemaphoreNew(1, 1, &semAttr);
  semID2 = osSemaphoreNew(1, 0, &semAttr);

  general_init_sem(0);

  ThreadID1 = osThreadNew(Producer_0, NULL, NULL);
  ThreadID2 = osThreadNew(Consumer_0, NULL, NULL);
  /* add events, ... */
  /* USER CODE END RTOS_EVENTS */

  /* Start scheduler */
  osKernelStart();

  /* We should never get here as control is now taken by the scheduler */
  /* Infinite loop */
  while (1)
  {

  }
}

void SystemClock_Config(void)
{
  RCC_OscInitTypeDef RCC_OscInitStruct = {0};
  RCC_ClkInitTypeDef RCC_ClkInitStruct = {0};

  /** Configure the main internal regulator output voltage
  */
  if (HAL_PWREx_ControlVoltageScaling(PWR_REGULATOR_VOLTAGE_SCALE0) != HAL_OK)
  {
    Error_Handler();
  }

  /** Initializes the RCC Oscillators according to the specified parameters
  * in the RCC_OscInitTypeDef structure.
  */
  RCC_OscInitStruct.OscillatorType = RCC_OSCILLATORTYPE_MSI;
  RCC_OscInitStruct.MSIState = RCC_MSI_ON;
  RCC_OscInitStruct.MSICalibrationValue = RCC_MSICALIBRATION_DEFAULT;
  RCC_OscInitStruct.MSIClockRange = RCC_MSIRANGE_6;
  RCC_OscInitStruct.PLL.PLLState = RCC_PLL_ON;
  RCC_OscInitStruct.PLL.PLLSource = RCC_PLLSOURCE_MSI;
  RCC_OscInitStruct.PLL.PLLM = 1;
  RCC_OscInitStruct.PLL.PLLN = 55;
  RCC_OscInitStruct.PLL.PLLP = RCC_PLLP_DIV7;
  RCC_OscInitStruct.PLL.PLLQ = RCC_PLLQ_DIV2;
  RCC_OscInitStruct.PLL.PLLR = RCC_PLLR_DIV2;
  if (HAL_RCC_OscConfig(&RCC_OscInitStruct) != HAL_OK)
  {
    Error_Handler();
  }

  /** Initializes the CPU, AHB and APB buses clocks
  */
  RCC_ClkInitStruct.ClockType = RCC_CLOCKTYPE_HCLK|RCC_CLOCKTYPE_SYSCLK
                              |RCC_CLOCKTYPE_PCLK1|RCC_CLOCKTYPE_PCLK2;
  RCC_ClkInitStruct.SYSCLKSource = RCC_SYSCLKSOURCE_PLLCLK;
  RCC_ClkInitStruct.AHBCLKDivider = RCC_SYSCLK_DIV1;
  RCC_ClkInitStruct.APB1CLKDivider = RCC_HCLK_DIV1;
  RCC_ClkInitStruct.APB2CLKDivider = RCC_HCLK_DIV1;

  if (HAL_RCC_ClockConfig(&RCC_ClkInitStruct, FLASH_LATENCY_5) != HAL_OK)
  {
    Error_Handler();
  }
}

static void MX_ICACHE_Init(void)
{

  /** Enable instruction cache in 1-way (direct mapped cache)
  */
  if (HAL_ICACHE_ConfigAssociativityMode(ICACHE_1WAY) != HAL_OK)
  {
    Error_Handler();
  }
  if (HAL_ICACHE_Enable() != HAL_OK)
  {
    Error_Handler();
  }

}

/* USER CODE BEGIN 4 */
int GetRandomDelay() {
    return (rand() % (RDIV * RAMT)) + RMIN;
}

int produce(void) {
    Delay(GetRandomDelay());
    return rand() % 20;
}

void consume(int datum) {
    Delay(GetRandomDelay());
}

void append(int datum) {
    buffer[i] = datum;
    Delay(GetRandomDelay());
    i++;
}

int extract(void) {
    i--;
    Delay(GetRandomDelay());
    return buffer[i];
}

void general_init_sem(int initial_value) {
    semIDA = osSemaphoreNew(1, 1, &semAttr);
    semIDB = osSemaphoreNew(1, MIN(1, initial_value), &semAttr);
    tickets = initial_value;
}

void general_wait_sem(void) {
    osSemaphoreAcquire(semIDB, osWaitForever);
    osSemaphoreAcquire(semIDA, osWaitForever);
    tickets--;
    if (tickets > 0) {
        osSemaphoreRelease(semIDB);
    }
    osSemaphoreRelease(semIDA);
}

void general_send_sem(void) {
    osSemaphoreAcquire(semIDA, osWaitForever);
    tickets++;
    if (tickets == 1) {
        osSemaphoreRelease(semIDB);
    }
    osSemaphoreRelease(semIDA);
}

// Producer & Consumer 0: No Sync
void Producer_0(void *arg) {
    for (;;) {
        BSP_LED_On(LED2);
        producer_datum = produce();
        append(producer_datum);
        BSP_LED_Off(LED2);
        Delay(GetRandomDelay());
    }
}

void Consumer_0(void *arg) {
    for (;;) {
        BSP_LED_On(LED1);
        consumer_datum = extract();
        consume(consumer_datum);
        BSP_LED_Off(LED1);
        Delay(GetRandomDelay());
    }
}

// Producer & Consumer 1: Mutex
void Producer_1(void *arg) {
    for (;;) {
        BSP_LED_On(LED3);
        producer_datum = produce();
        osMutexAcquire(mutexID, osWaitForever);
        append(producer_datum);
        osMutexRelease(mutexID);
        BSP_LED_Off(LED3);
        Delay(GetRandomDelay());
    }
}

void Consumer_1(void *arg) {
    for (;;) {
        BSP_LED_On(LED2);
        osMutexAcquire(mutexID, osWaitForever);
        consumer_datum = extract();
        osMutexRelease(mutexID);
        consume(consumer_datum);
        BSP_LED_Off(LED2);
        Delay(GetRandomDelay());
    }
}

// Producer & Consumer 2: 1 Semaphore
void Producer_2(void *arg) {
    for (;;) {
        BSP_LED_On(LED3);
        producer_datum = produce();
        append(producer_datum);
        osSemaphoreRelease(semID);
        BSP_LED_Off(LED3);
        Delay(GetRandomDelay());
    }
}

void Consumer_2(void *arg) {
    for (;;) {
        BSP_LED_On(LED2);
        osSemaphoreAcquire(semID, osWaitForever);
        consumer_datum = extract();
        consume(consumer_datum);
        BSP_LED_Off(LED2);
        Delay(GetRandomDelay());
    }
}

// Producer & Consumer 3: Two Semaphores
void Producer_3(void *arg) {
    for (;;) {
        BSP_LED_On(LED3);
        producer_datum = produce();
        osSemaphoreAcquire(semID1, osWaitForever);
        append(producer_datum);
        osSemaphoreRelease(semID1);
        osSemaphoreRelease(semID2);
        BSP_LED_Off(LED3);
        Delay(GetRandomDelay());
    }
}

void Consumer_3(void *arg) {
    for (;;) {
        BSP_LED_On(LED2);
        osSemaphoreAcquire(semID2, osWaitForever);
        osSemaphoreAcquire(semID1, osWaitForever);
        consumer_datum = extract();
        osSemaphoreRelease(semID1);
        consume(consumer_datum);
        BSP_LED_Off(LED2);
        Delay(GetRandomDelay());
    }
}

// Producer & Consumer 4: Swapped sem_send
void Producer_4(void *arg) {
    for (;;) {
        BSP_LED_On(LED3);
        producer_datum = produce();
        osSemaphoreAcquire(semID1, osWaitForever);
        append(producer_datum);
        osSemaphoreRelease(semID2);
        osSemaphoreRelease(semID1);
        BSP_LED_Off(LED3);
        Delay(GetRandomDelay());
    }
}

void Consumer_4(void *arg) {
    for (;;) {
        BSP_LED_On(LED2);
        osSemaphoreAcquire(semID2, osWaitForever);
        osSemaphoreAcquire(semID1, osWaitForever);
        consumer_datum = extract();
        osSemaphoreRelease(semID1);
        consume(consumer_datum);
        BSP_LED_Off(LED2);
        Delay(GetRandomDelay());
    }
}

// Producer & Consumer 5: Swapped sem_wait with deadlock
void Producer_5(void *arg) {
    for (;;) {
        BSP_LED_On(LED3);
        producer_datum = produce();
        osSemaphoreAcquire(semID1, osWaitForever);
        append(producer_datum);
        osSemaphoreRelease(semID1);
        osSemaphoreRelease(semID2);
        BSP_LED_Off(LED3);
        Delay(GetRandomDelay());
    }
}

void Consumer_5(void *arg) {
    for (;;) {
        BSP_LED_On(LED2);
        osSemaphoreAcquire(semID1, osWaitForever);
        Delay(GetRandomDelay());
        Delay(GetRandomDelay());
        osSemaphoreAcquire(semID2, osWaitForever);
        consumer_datum = extract();
        osSemaphoreRelease(semID1);
        consume(consumer_datum);
        BSP_LED_Off(LED2);
        Delay(GetRandomDelay());
    }
}

// Producer & Consumer 6: Mutex + Semaphore
void Producer_6(void *arg) {
    for (;;) {
        BSP_LED_On(LED3);
        producer_datum = produce();
        osMutexAcquire(mutexID, osWaitForever);
        append(producer_datum);
        osMutexRelease(mutexID);
        osSemaphoreRelease(semID);
        BSP_LED_Off(LED3);
        Delay(GetRandomDelay());
    }
}

void Consumer_6(void *arg) {
    for (;;) {
        BSP_LED_On(LED2);
        osSemaphoreAcquire(semID, osWaitForever);
        osMutexAcquire(mutexID, osWaitForever);
        consumer_datum = extract();
        osMutexRelease(mutexID);
        consume(consumer_datum);
        BSP_LED_Off(LED2);
        Delay(GetRandomDelay());
    }
}
/* USER CODE END 4 */

void Error_Handler(void)
{
  while(1)
  {
  }
}

#ifdef  USE_FULL_ASSERT
/**
  * @brief  Reports the name of the source file and the source line number
  *         where the assert_param error has occurred.
  * @param  file: pointer to the source file name
  * @param  line: assert_param error line source number
  * @retval None
  */
void assert_failed(uint8_t *file, uint32_t line)
{
  /* USER CODE BEGIN 6 */
  /* User can add his own implementation to report the file name and line number,
     ex: printf("Wrong parameters value: file %s on line %d\r\n", file, line) */

  /* Infinite loop */
  while (1)
  {}
  /* USER CODE END 6 */
}
#endif /* USE_FULL_ASSERT */
