# file: FreeRTOS_Timers.ioc
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FREERTOS.HEAP_NUMBER=4
FREERTOS.INCLUDE_eTaskGetState=1
FREERTOS.INCLUDE_pcTaskGetTaskName=0
FREERTOS.INCLUDE_uxTaskGetStackHighWaterMark=1
FREERTOS.INCLUDE_uxTaskPriorityGet=1
FREERTOS.INCLUDE_vTaskCleanUpResources=1
FREERTOS.INCLUDE_vTaskDelay=1
FREERTOS.INCLUDE_vTaskDelayUntil=1
FREERTOS.INCLUDE_vTaskDelete=1
FREERTOS.INCLUDE_vTaskPrioritySet=1
FREERTOS.INCLUDE_vTaskSuspend=1
FREERTOS.INCLUDE_xEventGroupSetBitFromISR=0
FREERTOS.INCLUDE_xQueueGetMutexHolder=1
FREERTOS.INCLUDE_xSemaphoreGetMutexHolder=0
FREERTOS.INCLUDE_xTaskAbortDelay=0
FREERTOS.INCLUDE_xTaskGetCurrentTaskHandle=1
FREERTOS.INCLUDE_xTaskGetHandle=0
FREERTOS.INCLUDE_xTaskGetSchedulerState=1
FREERTOS.INCLUDE_xTaskResumeFromISR=0
FREERTOS.INCLUDE_xTimerPendFunctionCall=1
FREERTOS.Tasks01=LEDThread,24,512,ToggleLEDsThread,Default,NULL,Dynamic,NULL,NULL
FREERTOS.Timers01=LEDTimer,osTimerCallback,osTimerPeriodic,Default,NULL,Dynamic,NULL
FREERTOS.configCHECK_FOR_STACK_OVERFLOW=0
FREERTOS.configENABLE_BACKWARD_COMPATIBILITY=0
FREERTOS.configENABLE_FPU=1
FREERTOS.configGENERATE_RUN_TIME_STATS=0
FREERTOS.configIDLE_SHOULD_YIELD=1
FREERTOS.configLIBRARY_LOWEST_INTERRUPT_PRIORITY=7
FREERTOS.configLIBRARY_MAX_SYSCALL_INTERRUPT_PRIORITY=5
FREERTOS.configMAX_CO_ROUTINE_PRIORITIES=2
FREERTOS.configMAX_TASK_NAME_LEN=16
FREERTOS.configMINIMAL_STACK_SIZE=512
FREERTOS.configQUEUE_REGISTRY_SIZE=8
FREERTOS.configRECORD_STACK_HIGH_ADDRESS=0
FREERTOS.configTICK_RATE_HZ=1000
FREERTOS.configTIMER_QUEUE_LENGTH=10
FREERTOS.configTIMER_TASK_PRIORITY=2
FREERTOS.configTIMER_TASK_STACK_DEPTH=1024
FREERTOS.configTOTAL_HEAP_SIZE=8120
FREERTOS.configUSE_APPLICATION_TASK_TAG=0
FREERTOS.configUSE_COUNTING_SEMAPHORES=1
FREERTOS.configUSE_CO_ROUTINES=0
FREERTOS.configUSE_DAEMON_TASK_STARTUP_HOOK=0
FREERTOS.configUSE_IDLE_HOOK=0
FREERTOS.configUSE_MALLOC_FAILED_HOOK=0
FREERTOS.configUSE_MUTEXES=1
FREERTOS.configUSE_PREEMPTION=1
FREERTOS.configUSE_RECURSIVE_MUTEXES=1
FREERTOS.configUSE_STATS_FORMATTING_FUNCTIONS=0
FREERTOS.configUSE_TASK_NOTIFICATIONS=1
FREERTOS.configUSE_TICKLESS_IDLE=0
FREERTOS.configUSE_TICK_HOOK=0
FREERTOS.configUSE_TRACE_FACILITY=1
Mcu.Family=STM32L5
Mcu.Name=STM32L552Z(C-E)TxQ
Mcu.Package=LQFP144
Mcu.TrustZone=disable
NVIC.PriorityGroup=NVIC_PRIORITYGROUP_3
NVIC.TIM6_IRQn=true\:0\:0\:false\:false\:true\:false\:false\:true
NVIC.TimeBase=TIM6_IRQn
NVIC.TimeBaseIP=TIM6
ProjectManager.HeapSize=0x400
ProjectManager.StackSize=0x800
ProjectManager.TargetToolchain=EWARM V8.32
RCC.ADCCLockSelection=RCC_ADCCLKSOURCE_SYSCLK
RCC.ADCFreq_Value=110000000
RCC.AHBFreq_Value=110000000
RCC.APB1Freq_Value=110000000
RCC.APB1TimFreq_Value=110000000
RCC.APB2Freq_Value=110000000
RCC.APB2TimFreq_Value=110000000
RCC.CK48CLockSelection=RCC_USBCLKSOURCE_MSI
RCC.CortexFreq_Value=110000000
RCC.DATA_CACHE_ENABLE=0
RCC.HCLKFreq_Value=110000000
RCC.HSE_VALUE=16000000
RCC.HSI48_VALUE=48000000
RCC.HSI_VALUE=16000000
RCC.I2C1CLockSelection=RCC_I2C1CLKSOURCE_SYSCLK
RCC.I2C3CLockSelection=RCC_I2C3CLKSOURCE_HSI
RCC.INSTRUCTION_CACHE_ENABLE=0
RCC.LSE_VALUE=32768
RCC.MSI_VALUE=4000000
RCC.PLLN=55
RCC.PLLSAI1N=24
RCC.SYSCLKFreq_VALUE=110000000
RCC.SYSCLKSource=RCC_SYSCLKSOURCE_PLLCLK
RCC.USBFreq_Value=4000000
RCC.VCOOutputFreq_Value=220000000
VP_FREERTOS_VS_CMSIS_V2.Mode=CMSIS_V2
VP_ICACHE_VS_ICACHE.Mode=DirectMappedCache
VP_PWR_VS_DBSignals.Mode=DisableDeadBatterySignals
VP_SYS_VS_tim6.Mode=TIM6
board=custom

// file: Src/main.c
#include "main.h"
#include "cmsis_os.h"

/* USER CODE BEGIN Includes */

#define SCHED_PRE_PRI   0
#define SCHED_NPRE_PRI  1
#define SCHED_NPRE_NPRI 0

#define RED   LED3
#define GREEN LED1
#define BLUE  LED2
/* USER CODE END Includes */

/* USER CODE BEGIN PTD */
#define Thread_PERIOD     1000     // in ms
#define Thread_DURATION   300      // in ms
#define TOP_PRIORITY    osPriorityHigh
#define PS_PRIORITY     osPriorityHigh
#define RED_PRIORITY    osPriorityAboveNormal
#define BLUE_PRIORITY   osPriorityNormal
#define GREEN_PRIORITY  osPriorityBelowNormal
/* USER CODE END PTD */

osThreadId_t t_PSHandle;
osThreadId_t t_TRLHandle;
osThreadId_t t_TBLHandle;
osThreadId_t t_TGLHandle;

/* USER CODE BEGIN PV */
__IO uint32_t TimeCounter = 0;
/* USER CODE END PV */
const osThreadAttr_t Thread_PS_attr = {
    .name = "PollSwitch",
    .priority = PS_PRIORITY,
    .stack_size = 128 * 4
};

const osThreadAttr_t Thread_R_attr = {
    .name = "RedLED",
    .priority = RED_PRIORITY,
    .stack_size = 128 * 4
};

const osThreadAttr_t Thread_B_attr = {
    .name = "BlueLED",
    .priority = BLUE_PRIORITY,
    .stack_size = 128 * 4
};

const osThreadAttr_t Thread_G_attr = {
    .name = "GreenLED",
    .priority = GREEN_PRIORITY,
    .stack_size = 128 * 4
};

void DelayBusy(uint32_t ms)
{
    uint32_t count = ms * 100000;
    while (count--) {
        __NOP();
    }
}

void SystemClock_Config(void);
static void MX_ICACHE_Init(void);
void ToggleLEDsThread(void *argument);
void osTimerCallback(void *argument);
void Thread_Poll_Switch(void *argument);
void Thread_ControlRedLED(void *argument);
void Thread_ControlBlueLED(void *argument);
void Thread_ControlGreenLED(void *argument);

int main(void)
{
	// USER Button - GPIOC PIN13 (input, pulled down)
	__HAL_RCC_GPIOC_CLK_ENABLE();

	GPIO_InitTypeDef GPIO_InitStruct = {0};
	GPIO_InitStruct.Pin = GPIO_PIN_13;
	GPIO_InitStruct.Mode = GPIO_MODE_INPUT;
	GPIO_InitStruct.Pull = GPIO_NOPULL;  // or GPIO_PULLDOWN if needed
	HAL_GPIO_Init(GPIOC, &GPIO_InitStruct);

  /* MCU Configuration--------------------------------------------------------*/

  /* Reset of all peripherals, Initializes the Flash interface and the Systick. */
  HAL_Init();

  /* Configure the system clock */
  SystemClock_Config();

  /* USER CODE BEGIN SysInit */
  /* Initialize LEDs */
	BSP_LED_Init(RED);
  BSP_LED_Init(GREEN);
  BSP_LED_Init(BLUE);
  /* USER CODE END SysInit */

  /* Initialize all configured peripherals */
  MX_ICACHE_Init();

  /* Init scheduler */
  osKernelInitialize();

  /* Create the timer(s) */
  /* creation of LEDTimer */
	t_PSHandle = osThreadNew(Thread_Poll_Switch, NULL, &Thread_PS_attr);
  t_TRLHandle = osThreadNew(Thread_ControlRedLED, NULL, &Thread_R_attr);
  t_TBLHandle = osThreadNew(Thread_ControlBlueLED, NULL, &Thread_B_attr);
  t_TGLHandle = osThreadNew(Thread_ControlGreenLED, NULL, &Thread_G_attr);

  /* Start scheduler */
  osKernelStart();

  /* We should never get here as control is now taken by the scheduler */
  /* Infinite loop */
  while (1)
  {

  }
}

void SystemClock_Config(void)
{
  RCC_OscInitTypeDef RCC_OscInitStruct = {0};
  RCC_ClkInitTypeDef RCC_ClkInitStruct = {0};

  /** Configure the main internal regulator output voltage
  */
  if (HAL_PWREx_ControlVoltageScaling(PWR_REGULATOR_VOLTAGE_SCALE0) != HAL_OK)
  {
    Error_Handler();
  }

  /** Initializes the RCC Oscillators according to the specified parameters
  * in the RCC_OscInitTypeDef structure.
  */
  RCC_OscInitStruct.OscillatorType = RCC_OSCILLATORTYPE_MSI;
  RCC_OscInitStruct.MSIState = RCC_MSI_ON;
  RCC_OscInitStruct.MSICalibrationValue = RCC_MSICALIBRATION_DEFAULT;
  RCC_OscInitStruct.MSIClockRange = RCC_MSIRANGE_6;
  RCC_OscInitStruct.PLL.PLLState = RCC_PLL_ON;
  RCC_OscInitStruct.PLL.PLLSource = RCC_PLLSOURCE_MSI;
  RCC_OscInitStruct.PLL.PLLM = 1;
  RCC_OscInitStruct.PLL.PLLN = 55;
  RCC_OscInitStruct.PLL.PLLP = RCC_PLLP_DIV7;
  RCC_OscInitStruct.PLL.PLLQ = RCC_PLLQ_DIV2;
  RCC_OscInitStruct.PLL.PLLR = RCC_PLLR_DIV2;
  if (HAL_RCC_OscConfig(&RCC_OscInitStruct) != HAL_OK)
  {
    Error_Handler();
  }

  /** Initializes the CPU, AHB and APB buses clocks
  */
  RCC_ClkInitStruct.ClockType = RCC_CLOCKTYPE_HCLK|RCC_CLOCKTYPE_SYSCLK
                              |RCC_CLOCKTYPE_PCLK1|RCC_CLOCKTYPE_PCLK2;
  RCC_ClkInitStruct.SYSCLKSource = RCC_SYSCLKSOURCE_PLLCLK;
  RCC_ClkInitStruct.AHBCLKDivider = RCC_SYSCLK_DIV1;
  RCC_ClkInitStruct.APB1CLKDivider = RCC_HCLK_DIV1;
  RCC_ClkInitStruct.APB2CLKDivider = RCC_HCLK_DIV1;

  if (HAL_RCC_ClockConfig(&RCC_ClkInitStruct, FLASH_LATENCY_5) != HAL_OK)
  {
    Error_Handler();
  }
}

static void MX_ICACHE_Init(void)
{

  /** Enable instruction cache in 1-way (direct mapped cache)
  */
  if (HAL_ICACHE_ConfigAssociativityMode(ICACHE_1WAY) != HAL_OK)
  {
    Error_Handler();
  }
  if (HAL_ICACHE_Enable() != HAL_OK)
  {
    Error_Handler();
  }

}

void Poll_Switch(void) {
#if SCHED_NPRE_PRI
    osThreadSetPriority(osThreadGetId(), TOP_PRIORITY);
#endif
    while (HAL_GPIO_ReadPin(GPIOC, GPIO_PIN_13) == GPIO_PIN_SET) {
        BSP_LED_On(RED);
        BSP_LED_On(BLUE);
        BSP_LED_On(GREEN);
        DelayBusy(10);
        BSP_LED_Off(RED);
        BSP_LED_Off(BLUE);
        BSP_LED_Off(GREEN);
        DelayBusy(10);
    }
#if SCHED_NPRE_PRI
    osThreadSetPriority(osThreadGetId(), PS_PRIORITY);
#endif
}

void ControlRedLED(void) {
#if SCHED_NPRE_PRI
    osThreadSetPriority(osThreadGetId(), TOP_PRIORITY);
#endif
    BSP_LED_On(RED);
    DelayBusy(Thread_DURATION);
    BSP_LED_Off(RED);
#if SCHED_NPRE_PRI
    osThreadSetPriority(osThreadGetId(), RED_PRIORITY);
#endif
}

void ControlBlueLED(void) {
#if SCHED_NPRE_PRI
    osThreadSetPriority(osThreadGetId(), TOP_PRIORITY);
#endif
    BSP_LED_On(BLUE);
    DelayBusy(Thread_DURATION);
    BSP_LED_Off(BLUE);
#if SCHED_NPRE_PRI
    osThreadSetPriority(osThreadGetId(), BLUE_PRIORITY);
#endif
}

void ControlGreenLED(void) {
#if SCHED_NPRE_PRI
    osThreadSetPriority(osThreadGetId(), TOP_PRIORITY);
#endif
    BSP_LED_On(GREEN);
    DelayBusy(Thread_DURATION);
    BSP_LED_Off(GREEN);
#if SCHED_NPRE_PRI
    osThreadSetPriority(osThreadGetId(), GREEN_PRIORITY);
#endif
}

void Thread_Poll_Switch(void *argument) {
    (void)argument;
#if (SCHED_PRE_PRI || SCHED_NPRE_PRI)
    for (;;) {
        Poll_Switch();
        osDelay(1);
    }
#elif SCHED_NPRE_NPRI
    Poll_Switch();
    osThreadExit();
#endif
}

void Thread_ControlRedLED(void *argument) {
    (void)argument;
#if (SCHED_PRE_PRI || SCHED_NPRE_PRI)
    for (;;) {
        ControlRedLED();
        osDelay(Thread_PERIOD);
    }
#elif SCHED_NPRE_NPRI
    ControlRedLED();
    osThreadExit();
#endif
}

void Thread_ControlBlueLED(void *argument) {
    (void)argument;
#if (SCHED_PRE_PRI || SCHED_NPRE_PRI)
    for (;;) {
        ControlBlueLED();
        osDelay(Thread_PERIOD);
    }
#elif SCHED_NPRE_NPRI
    ControlBlueLED();
    osThreadExit();
#endif
}

void Thread_ControlGreenLED(void *argument) {
    (void)argument;
#if (SCHED_PRE_PRI || SCHED_NPRE_PRI)
    for (;;) {
        ControlGreenLED();
        osDelay(Thread_PERIOD);
    }
#elif SCHED_NPRE_NPRI
    ControlGreenLED();
    osThreadExit();
#endif
}

void HAL_TIM_PeriodElapsedCallback(TIM_HandleTypeDef *htim)
{
  if (htim->Instance == TIM6) {
    HAL_IncTick();
  }
}

void Error_Handler(void)
{
  while(1)
  {
  }
}

#ifdef  USE_FULL_ASSERT
/**
  * @brief  Reports the name of the source file and the source line number
  *         where the assert_param error has occurred.
  * @param  file: pointer to the source file name
  * @param  line: assert_param error line source number
  * @retval None
  */
void assert_failed(uint8_t *file, uint32_t line)
{
  /* USER CODE BEGIN 6 */
  /* User can add his own implementation to report the file name and line number,
     ex: printf("Wrong parameters value: file %s on line %d\r\n", file, line) */

  /* Infinite loop */
  while (1)
  {}
  /* USER CODE END 6 */
}
#endif /* USE_FULL_ASSERT */
